## micronuts-esp32-bridge/sdkconfig.defaults
```kconfig
CONFIG_ESP_MAIN_TASK_STACK_SIZE=8192
CONFIG_ESP_SYSTEM_MEMPROT_FEATURE=y
CONFIG_PARTITION_TABLE_SINGLE_APP=y
CONFIG_ESP_WIFI_STA_DISCONNECTED_PM_BEACON_TIMEOUT=100
```
